## boards/arm/delfast_pc_001/Kconfig.defconfig
```kconfig
# SPDX-License-Identifier: Apache-2.0
#
# Delfast PC-001 board configuration
#
# Copyright (c) 2021 BaDen
# Author: Batrak Denys <baden.i.ua@gmail.com>

if BOARD_DELFAST_PC_001

config BOARD
	default "delfast_pc_001"

endif # BOARD_DELFAST_PC_001
```

## drivers/flash/Kconfig
```kconfig
comment "Flash Drivers"

if FLASH

module = FLASH
module-str = flash

rsource "Kconfig.m48x"
rsource "Kconfig.spim_m48x"

endif # FLASH
```

## drivers/flash/Kconfig.m48x
```kconfig
# Nuvoton M48X flash driver config

# Copyright (c) 2021 BaDen baden.i.ua@gmail.com
# SPDX-License-Identifier: Apache-2.0

menuconfig SOC_FLASH_M48X
	bool "Nuvoton M48X flash driver"
	default y
	#depends on SOC_FAMILY_M48X
	depends on SOC_FAMILY_NUMICRO
	#depends on CONFIG_SOC_M487
	select FLASH_HAS_PAGE_LAYOUT
	select FLASH_HAS_DRIVER_ENABLED
	select MPU_ALLOW_FLASH_WRITE if ARM_MPU
	help
	  Enable the Nuvoton M48X series internal flash driver.

# config SOC_FLASH_M48X_EMULATE_BYTE_PAGES
# 	bool "Emulate byte-sized pages"
# 	depends on SOC_FLASH_M48X
# 	help
# 	  Emulate a device with byte-sized pages by doing a
# 	  read/modify/erase/write.
```

## drivers/flash/Kconfig.spim_m48x
```kconfig
# Nuvoton SPIM M48X flash driver config
# This is not Zephyr style solution. Try to use 'jedec,spi-nor' compatible driver.
# Care: this driver hardcoded to Delfast PC-001 board

# Copyright (c) 2021 BaDen
# Author: baden.i.ua@gmail.com
# SPDX-License-Identifier: Apache-2.0

menuconfig SOC_FLASH_SPIM_M48X
	bool "Nuvoton M48X SPIM flash driver"
	default y
	#depends on SOC_FAMILY_M48X
	depends on SOC_FAMILY_NUMICRO
	#depends on CONFIG_SOC_M487
	#select FLASH_HAS_PAGE_LAYOUT
	#select FLASH_HAS_DRIVER_ENABLED
	#select MPU_ALLOW_FLASH_WRITE if ARM_MPU
	help
	  Enable the Nuvoton SPIM M48X series internal flash driver.

config SPIM_FLASH_M48X_USE_DMA
	bool "Try to use SPIM DMA"
	default n
	
```

## drivers/pinmux/Kconfig
```kconfig
# Nuvorton M48x pinmux configuration options

# Copyright (c) 2021 Denys (baden.i.ua@gmail.com)
# SPDX-License-Identifier: Apache-2.0

config PINMUX_M48X
	bool "Nuvorton M48x pin multiplexer driver"
	default y
	depends on SOC_FAMILY_NUMICRO
	# SOC_SERIES_M48X ?
	help
	  Enable support for the Nuvorton M48x PORT pin multiplexer.
```

## drivers/sensor/examplesensor/Kconfig
```kconfig
# Copyright (c) 2021 Nordic Semiconductor ASA
# SPDX-License-Identifier: Apache-2.0

config EXAMPLESENSOR
	bool "Example sensor"
	default n
	depends on GPIO
	help
	  Enable example sensor
```

## drivers/serial/Kconfig
```kconfig
# Serial driver configuration options

# Copyright (c) 2014-2015 Wind River Systems, Inc.
# SPDX-License-Identifier: Apache-2.0

comment "Serial Drivers"

rsource "Kconfig.delfast"
```

## drivers/serial/Kconfig.delfast
```kconfig
# SPDX-License-Identifier: Apache-2.0
#
# DELFAST version of NUVOTON UART configuration
#
# Copyright (c) 2020 Linumiz, (c) 2021 Baden
# Author: Saravanan Sekar <saravanan@linumiz.com>, Batrak Denys <baden.i.ua@gmail.com>

config UART_DELFAST
	bool "DELFAST NUVOTON MCU serial driver"
	select SERIAL_HAS_DRIVER
	select HAS_NUMICRO_UART
	depends on SOC_FAMILY_NUMICRO
	help
	  This option enables the UART driver for Nuvoton Numicro (Delfast version)
	  family of processors.
	  Say y to use serial port on Nuvoton MCU.
```

## drivers/serial/Kconfig.m48x
```kconfig
# SPDX-License-Identifier: Apache-2.0
#
# DELFAST version of NUVOTON M48x-series UART configuration
#
# Copyright (c) 2020 Linumiz, (c) 2021 Baden
# Author: Saravanan Sekar <saravanan@linumiz.com>, Batrak Denys <baden.i.ua@gmail.com>

config UART_M48X
	bool "DELFAST NUVOTON M48x MCU serial driver"
	select SERIAL_HAS_DRIVER
	#select SERIAL_SUPPORT_INTERRUPT
	select HAS_NUMICRO_UART
	depends on SOC_FAMILY_NUMICRO
	help
	  This option enables the UART driver for Nuvoton M48x (May be hardcoded to Delfast PC-001)
	  family of processors.
	  Say y to use serial port on Nuvoton MCU.
```

## drivers/spi/Kconfig
```kconfig
# SPI driver configuration options

# Copyright (c) 2021 BaDen (baden.i.ua@gmail.com)
# SPDX-License-Identifier: Apache-2.0

comment "SPI Drivers"

if SPI
rsource "Kconfig.m48x"
endif # SPI
```

## drivers/spi/Kconfig.m48x
```kconfig
# SPDX-License-Identifier: Apache-2.0
#
# DELFAST version of NUVOTON M48x-series SPIM configuration
#
# Copyright (c) 2021 Baden
# Author: Batrak Denys <baden.i.ua@gmail.com>

config SPI_M48X
	bool "DELFAST NUVOTON M48x MCU SPIM driver"
	default y
	select DMA if SPI_ASYNC
	depends on SOC_FAMILY_NUMICRO
	help
	  Enable support for the Nuvoton M48x SPIM driver.
```

## drivers/watchdog/Kconfig.m48x
```kconfig
# WDT support

config WDT_M48X
	bool "Nuvoton M48X WDT driver"
	default y
	depends on SOC_FAMILY_NUMICRO
	#select NRFX_WDT0 if HAS_HW_NRF_WDT0
	#select NRFX_WDT1 if HAS_HW_NRF_WDT1
	help
	  Enable support for WDT driver for Nuvoton MCU series.
```

## dts/bindings/crypto/nuvoton,m48x-aes.yaml
```yaml
# Copyright (c) 2021, Thomas Stranger
# SPDX-License-Identifier: Apache-2.0

description: Nuvoton AES Accelerator

compatible: "nuvoton,m48x-aes"

include: nuvoton,m48x-crypto-common.yaml
```

## dts/bindings/flash_controller/nuvoton,m48x-spi.yaml
```yaml
description: Nuvoton M48x Family SPIM flash controller

compatible: "nuvoton,m48x-spim-flash-controller"

include: flash-controller.yaml
```

## dts/bindings/gpio/nuvoton,m48x-gpio.yaml
```yaml
# Copyright (c) 2021 BaDen Ukraine
# SPDX-License-Identifier: Apache-2.0

description: Delfast GPIO node

compatible: "nuvoton,m48x-gpio"

include: [gpio-controller.yaml, base.yaml]

properties:
    label:
      required: true

    "#gpio-cells":
      const: 2

gpio-cells:
  - pin
  - flags

foo-cells:
  - foocell
```

## dts/bindings/serial/nuvoton,m48x-uart.yaml
```yaml
description: NUVOTON M84x NUMICRO FAMILY UART

compatible: "nuvoton,m48x-uart"

include: uart-controller.yaml

properties:
    reg:
      required: true

    interrupts:
      required: true

    peripheral-id:
        type: int
        description: peripheral ID (0..7)
        required: true

    clk-src:
        type: int
        description: Clock source. Like CLK_CLKSEL1_UART0SEL_HXT
        required: true

    clk-div:
        type: int
        description: Clock divider. Like CLK_CLKDIV0_UART0_1
        required: true

    tx-port:
      type: string
      required: true
      enum:
        - "A"
        - "B"
        - "C"
        - "D"
        - "E"
        - "F"
        - "G"
        - "H"

    tx-pin:
      type: string
      required: true

    rx-port:
      type: string
      required: true
      enum:
        - "A"
        - "B"
        - "C"
        - "D"
        - "E"
        - "F"
        - "G"
        - "H"

    rx-pin:
      type: string
      required: true

    rx-gpios:
      type: phandle-array
      required: false

    rx-gpio:
      type: phandle
      required: false

    tx-gpios:
      type: phandle-array
      required: false

    pinctrl-0:
      type: phandles
      required: false
      description: configurations of pinmux controllers
```

## dts/bindings/watchdog/nuvoton,m48x-watchdog.yaml
```yaml
description: Nuvoton M48X watchdog

compatible: "nuvoton,m48x-watchdog"

include: base.yaml

properties:
    reg:
      required: true

    interrupts:
      required: true
```

## soc/arm/nuvoton_m48x/Kconfig
```kconfig
# SPDX-License-Identifier: Apache-2.0
#
# Copyright (c) 2020 Linumiz
# Author: Saravanan Sekar <saravanan@linumiz.com>


config SOC_FAMILY_M48X
	select PLATFORM_SPECIFIC_INIT
	bool

if SOC_FAMILY_M48X
config SOC_FAMILY
	string
	default "nuvoton_m48x"

rsource "*/Kconfig.soc"

endif # SOC_FAMILY_M48X
```

## west.yml
```yaml
# Copyright (c) 2021 BaDen
# SPDX-License-Identifier: Apache-2.0

manifest:
  self:
    path: zephyr-nuvoton

  remotes:
    - name: zephyrproject-rtos
      url-base: https://github.com/zephyrproject-rtos
  projects:
    - name: hal_nuvoton
      remote: zephyrproject-rtos
      path: modules/hal/nuvoton
      # revision: main
      revision: b4d31f33238713a568e23618845702fadd67386f
      groups:
        - hal
```

## zephyr/boards/arm/delfast_pc_001/Kconfig.board
```kconfig
# SPDX-License-Identifier: Apache-2.0
#
# Delfast PC-001 board configuration
#
# Copyright (c) 2021 BaDen
# Author: Batrak Denys <baden.i.ua@gmail.com>

config BOARD_DELFAST_PC_001
	bool "Delfast PC-001 Bike Board"
	depends on SOC_M487
```

## zephyr/dts/bindings/gpio/delfast,gpio.yaml
```yaml
# Copyright (c) 2021 BaDen Ukraine
# SPDX-License-Identifier: Apache-2.0

description: Delfast GPIO node

compatible: "delfast,gpio"

include: [gpio-controller.yaml, base.yaml]

properties:
    label:
      required: true

    "#gpio-cells":
      const: 2

gpio-cells:
  - pin
  - flags

foo-cells:
  - foocell
```
