/*
 * Copyright (c) 2022 Batrak Denys <baden.i.ua@gmail.com>
 *
 * SPDX-License-Identifier: Apache-2.0
 */

/ {
	/*chosen {
		zephyr,entropy = &rng;
	};*/

	soc {
		aes: aes@50080000 {
			compatible = "nuvoton,m48x-aes";
			reg = <0x50080000 0x400>;
			/*clocks = <&rcc STM32_CLOCK_BUS_AHB1 0x00010000>;*/
			/*interrupts = <31 0>;*/
			status = "disabled";
			label = "AES";
		};

		/*rng: rng@40025000 {
			compatible = "st,stm32-rng";
			reg = <0x40025000 0x400>;
			interrupts = <31 1>;
			clocks = <&rcc STM32_CLOCK_BUS_AHB1 0x00040000>;
			status = "disabled";
			label = "RNG";
		};*/
	};
};
